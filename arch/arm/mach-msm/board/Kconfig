## arch/arm/mach-msm/board/Kconfig
```kconfig
choice
	depends on MACH_APQ8064_MTP
	prompt "APQ8064_MTP Based Board"

config MACH_APQ8064_MTP_ORIG
	bool "Original MACH_APQ8064 MTP"
	help
	  Support for Qualcomm MSM7x27 FFA original eval board.

config MACH_BOARD_ZTEMT_NUBIA
	bool "ZTEMT NUBIA"
	help
	  Support for the ZTEMT NUBIA board.

endchoice

config ZTEMT_NONSIGN_RILA
       default y
	bool 
	help
	  Support for the ZTEMT NONSIGN RILA
	  
config ZTEMT_HW_BOARD_TYPE
	bool "ZTEMT Hardware type"
	default y
	help
	 ZTEMT Hardware type
```

## drivers/input/touchscreen/zte_touch/Kconfig
```kconfig
menuconfig ZTE_TOUCHSCREEN
	bool "ZTE Touchscreens"
	help
	  Say Y here, and a list of supported touchscreens will be displayed.
	  This option doesn't affect the kernel.

	  If unsure, say Y.

if ZTE_TOUCHSCREEN

config ZTE_TOUCH_RESISTANCE
	tristate "ZTE resistance touchscreen"
	depends on ZTE_TOUCHSCREEN
	help
	  Say Y here if you have a resistance touchscreen
	  
	  If unsure, say N.

	  To compile this driver as a module, choose M here: the
	  module will be called zte_res_touch.
	  
config ZTE_TOUCH_CAPACITANCE
	bool "ZTE capacitance touchscreen"
	depends on ZTE_TOUCHSCREEN
	help
	  Say Y here if you gona enable the driver support the following projects:

	  =======================================	
	  Projects         IC            Vindor       

	              
	  =======================================	  

	  If unsure, say N.
	  
config TOUCHSCREEN_ZTE_ATMEL_MXT336
	tristate "Atmel_mxt336 driver"
	depends on ZTE_TOUCH_CAPACITANCE
	help
	  Say Y here if you have a Atmel_mxt336 touchscreen
	  
	  If unsure, say N.

	  To compile this driver as a module, choose M here: the
	  module will be called zte_cap_touch.	

config TOUCHSCREEN_ZTE_MELFAS_MMS144
	tristate "Melfas mms144 driver"
	depends on ZTE_TOUCH_CAPACITANCE
	help
	  Say Y here if you have a Melfas mms144 touchscreen
	  
	  If unsure, say N.

	  To compile this driver as a module, choose M here: the
	  module will be called zte_cap_touch.		  
endif
```
